## Kconfig
```kconfig
menu "on9log"

    choice ON9LOG_MAXIMUM_LEVEL_CHOICE
        prompt "Maximum compiled on9log level"
        default ON9LOG_MAXIMUM_LEVEL_INFO
        help
            Sets the default compile-time maximum level used by ON9_LOGx()
            macros when ON9_LOG_LOCAL_LEVEL is not defined before including
            on9log.h.

        config ON9LOG_MAXIMUM_LEVEL_NONE
            bool "None"

        config ON9LOG_MAXIMUM_LEVEL_ERROR
            bool "Error"

        config ON9LOG_MAXIMUM_LEVEL_WARN
            bool "Warning"

        config ON9LOG_MAXIMUM_LEVEL_INFO
            bool "Info"

        config ON9LOG_MAXIMUM_LEVEL_DEBUG
            bool "Debug"

        config ON9LOG_MAXIMUM_LEVEL_VERBOSE
            bool "Verbose"
    endchoice

    config ON9LOG_MAXIMUM_LEVEL
        int
        default 0 if ON9LOG_MAXIMUM_LEVEL_NONE
        default 1 if ON9LOG_MAXIMUM_LEVEL_ERROR
        default 2 if ON9LOG_MAXIMUM_LEVEL_WARN
        default 3 if ON9LOG_MAXIMUM_LEVEL_INFO
        default 4 if ON9LOG_MAXIMUM_LEVEL_DEBUG
        default 5 if ON9LOG_MAXIMUM_LEVEL_VERBOSE

    config ON9LOG_PLAIN_TEXT
        bool "Output plain text log instead of binary log"
        default n
        help
            If this option is enabled, then all output will be plain text
            instead of binary encoded log. All the format string and log tag
            string will be placed into .rodata instead of .noload. This only
            recommended for debug builds.

    config ON9LOG_MAX_SINKS
        int "Maximum on9log sinks"
        range 1 16
        default 4
        help
            Maximum number of callback sinks that the core on9log packet
            producer can register.

    config ON9LOG_BUFFER_CHUNK_SIZE
        int "Maximum buffer dump chunk size"
        range 1 65535
        default 3042
        help
            Maximum number of user buffer bytes emitted in one ON9LOG_PKT_BUFFER
            packet. The default fits the largest buffer chunk that the default
            ESP stdio VFS transport can forward in one frame.

    config ON9LOG_MAX_DYNAMIC_STRING_LEN
        int "Maximum dynamic string argument length"
        range 0 3048
        default 1024
        help
            Maximum number of bytes copied from a dynamic string argument. Longer
            strings are truncated to this length before being encoded into the
            log packet. The upper bound fits one dynamic string argument in the
            default 3072-byte ESP stdio VFS transport frame; logs with multiple
            large dynamic strings can still exceed the transport frame cap.

    config ON9LOG_ISR_PACKET_MAX
        int "Maximum encoded ISR log packet size"
        range 32 3072
        default 128
        help
            Maximum complete on9log packet size encoded on the stack by
            ON9_ISR_LOGx(). ISR logs that exceed this size are dropped.

    config ON9LOG_ESP_ISR_RINGBUF_SIZE
        int "ESP ISR log ringbuffer size"
        range 256 65536
        default 2048
        help
            Size in bytes of the ESP-IDF no-split ringbuffer used to transfer
            ON9_ISR_LOGx() packets from ISR context to the drain task. No-split
            ringbuffers require overhead and cannot use the whole buffer for one
            item, so keep this comfortably larger than twice
            CONFIG_ON9LOG_ISR_PACKET_MAX.

    config ON9LOG_ESP_ISR_DRAIN_TASK_STACK_SIZE
        int "ESP ISR log drain task stack size"
        range 2048 8192
        default 2048
        help
            Stack size in bytes for the ESP ISR log drain task.

    config ON9LOG_ESP_ISR_DRAIN_TASK_PRIORITY
        int "ESP ISR log drain task priority"
        range 1 24
        default 5
        help
            FreeRTOS priority for the task that drains ISR log packets and
            dispatches them through the normal on9log sink path.

endmenu
```
